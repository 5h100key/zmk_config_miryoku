## config/boards/shields/corne/Kconfig.defconfig
```kconfig
if SHIELD_CORNE_LEFT

config ZMK_KEYBOARD_NAME
	default "Corne Miryoku"

config ZMK_SPLIT_BLE_ROLE_CENTRAL
	default y

endif #Board_Corne_Left

if SHIELD_CORNE_LEFT || SHIELD_CORNE_RIGHT

config ZMK_SPLIT
    default y

endif # BOARD_CORNE_LEFT || BOARD_CORNE_RIGHT
```
